## Kconfig
```kconfig
# SPDX-License-Identifier: GPL-2.0-only

config DRM_LINDROID
	tristate "Lindroid KMS (EXPERIMENTAL)"
	depends on DRM && MMU
	select DRM_CLIENT_SELECTION
	select DRM_KMS_HELPER
	select DRM_GEM_SHMEM_HELPER
	select CRC32
	default n
	help
	  Lindroid DRM implements a virtual dri interface for lindroid Linux-on-Android container solution

	  If M is selected the module will be called lindroid_drm.
```
